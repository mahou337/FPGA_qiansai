/*
 * CAUTION: This file is automatically generated by PetaLinux SDK.
 * DO NOT modify this file
 */


/ {
	chosen {
		bootargs = "console=ttyPS0,115200 earlyprintk";
		stdout-path = "serial0:115200n8";
	};
};

